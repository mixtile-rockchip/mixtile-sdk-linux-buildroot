## configs/rockchip_rv1126b_fastboot_defconfig
```kconfig
#include "base/tiny.config"
#include "chips/rv1126b_aarch64.config"
BR2_TARGET_ROOTFS_EROFS=y
BR2_TARGET_ROOTFS_EROFS_GZIP=y
```

## package/python-pyqt5-sip/Config.in
```kconfig
config BR2_PACKAGE_PYTHON_PYQT5_SIP
	bool "python-pyqt5-sip"
	depends on BR2_PACKAGE_PYTHON_PYQT5
	depends on BR2_PACKAGE_PYTHON_SIP
	help
	  This is the PyQt5.sip module which is needed to run PyQt5.
```
