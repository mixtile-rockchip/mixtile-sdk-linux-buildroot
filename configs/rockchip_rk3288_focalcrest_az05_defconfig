## configs/rockchip_rk3288_focalcrest_az05_defconfig
```kconfig
#include "base/base.config"
#include "chips/rk3288_arm.config"
#include "fs/exfat.config"
#include "fs/vfat.config"
#include "gpu/mali.config"
#include "multimedia/audio.config"
#include "wifibt/bt.config"
#include "wifibt/wireless.config"
#include "tools/benchmark.config"
#include "tools/common.config"
#include "tools/test.config"
#include "gui/weston.config"
BR2_PACKAGE_FIO=y
BR2_PACKAGE_GREP=y
BR2_PACKAGE_CA_CERTIFICATES=y
BR2_PACKAGE_UTIL_LINUX_BINARIES=y
BR2_PACKAGE_ROCKCHIP_MALI_SUB_VERSION="all"
BR2_ROOTFS_POST_BUILD_SCRIPT+="board/rockchip/focalcrest/post-build.sh"
```

## configs/rockchip_rk3566_focalcrest_az07_defconfig
```kconfig
#include "base/base.config"
#include "bus/pci.config"
#include "chips/rk3566_rk3568_aarch64.config"
#include "fs/exfat.config"
#include "fs/vfat.config"
#include "gpu/mali.config"
#include "multimedia/audio.config"
#include "wifibt/bt.config"
#include "wifibt/wireless.config"
#include "tools/benchmark.config"
#include "tools/common.config"
#include "tools/test.config"
#include "gui/weston.config"
BR2_PACKAGE_CA_CERTIFICATES=y
BR2_PACKAGE_PRODUCTIONTOOL=y
BR2_ROOTFS_POST_BUILD_SCRIPT+="board/rockchip/focalcrest/post-build.sh"
```

## configs/rockchip_rk3588_focalcrest_az04a_defconfig
```kconfig
#include "base/base.config"
#include "bus/pci.config"
#include "chips/rk3588_aarch64.config"
#include "fs/exfat.config"
#include "fs/vfat.config"
#include "gpu/mali.config"
#include "multimedia/audio.config"
#include "wifibt/bt.config"
#include "wifibt/wireless.config"
#include "tools/benchmark.config"
#include "tools/common.config"
#include "tools/test.config"
BR2_PACKAGE_FIO=y
BR2_PACKAGE_GREP=y
BR2_PACKAGE_CA_CERTIFICATES=y
BR2_PACKAGE_UTIL_LINUX_BINARIES=y
```

## configs/rockchip_rk3588s_inmusic_az04b_defconfig
```kconfig
#include "base/base.config"
#include "bus/pci.config"
#include "chips/rk3588_aarch64.config"
#include "fs/exfat.config"
#include "fs/vfat.config"
#include "gpu/mali.config"
#include "multimedia/audio.config"
#include "wifibt/bt.config"
#include "wifibt/wireless.config"
#include "tools/benchmark.config"
#include "tools/common.config"
#include "tools/test.config"
#include "gui/weston.config"
BR2_PACKAGE_PRODUCTIONTOOL=y
BR2_ROOTFS_POST_BUILD_SCRIPT+="board/rockchip/inmusic/post-build.sh"
BR2_PACKAGE_CA_CERTIFICATES=y
```

## configs/rockchip_rv1126b_defconfig
```kconfig
#include "base/base.config"
#include "wifibt/bt.config"
#include "wifibt/wireless.config"
#include "chips/rv1126b_aarch64.config"
#include "font/chinese.config"
#include "fs/exfat.config"
#include "fs/ntfs.config"
#include "fs/vfat.config"
#include "multimedia/audio.config"
#include "multimedia/camera.config"
#include "multimedia/gst/audio.config"
#include "multimedia/gst/camera.config"
#include "multimedia/gst/rtsp.config"
#include "multimedia/gst/video.config"
#include "multimedia/mpp.config"
#include "tools/benchmark.config"
#include "tools/common.config"
#include "tools/test.config"
#include "gpu/mesa3d.config"
#include "gui/weston.config"
BR2_PACKAGE_ROCKCHIP_RGA=y
BR2_PACKAGE_WESTON_DEFAULT_PIXMAN=y
```

## configs/rockchip_rv1126b_ipc_defconfig
```kconfig
#include "base/base.config"
#include "wifibt/bt.config"
#include "wifibt/wireless.config"
#include "chips/rv1126b_aarch64.config"
#include "multimedia/mpp.config"
#include "multimedia/audio.config"
#include "multimedia/camera.config"
# BR2_PACKAGE_ALSA_UCM_CONF is reset to default
# BR2_PACKAGE_ALSA_UTILS is reset to default
BR2_PACKAGE_CAMERA_ENGINE=y
BR2_PACKAGE_COMMON_ALGORITHM=y
BR2_PACKAGE_IPC_DRV_KO=y
BR2_PACKAGE_IVA=y
BR2_PACKAGE_IVA_RV1126B=y
# BR2_PACKAGE_LIBMAD is reset to default
BR2_PACKAGE_LIBSNDFILE=y
BR2_PACKAGE_LIBTOOL=y
# BR2_PACKAGE_PULSEAUDIO is reset to default
BR2_PACKAGE_RKFSMK=y
BR2_PACKAGE_RKIPC=y
BR2_PACKAGE_RKIPC_RV1126B=y
BR2_ROOTFS_OVERLAY="board/rockchip/common/base board/rockchip/rv1126b/fs-overlay-ipc/"
```

## package/libmtp/Config.in
```kconfig
config BR2_PACKAGE_LIBMTP
	bool "libmtp"
	select BR2_PACKAGE_LIBUSB
	help
	  A library to access MTP (Media Transfer Protocol) Devices.

	  https://github.com/libmtp/libmtp
```

## package/productiontool/Config.in
```kconfig
config BR2_PACKAGE_PRODUCTIONTOOL
	bool "ProductionTool (factory / manufacturing test tool)"
	default n

	# Python runtime
	select BR2_PACKAGE_PYTHON3
	select BR2_PACKAGE_PYTHON3_UNICODEDATA
	select BR2_PACKAGE_PYTHON_CFFI
	select BR2_PACKAGE_PYTHON_DAEMON
	select BR2_PACKAGE_PYTHON_SETUPTOOLS
	select BR2_PACKAGE_PYTHON_PACKAGING
	select BR2_PACKAGE_PYTHON_PYPARSING
	select BR2_PACKAGE_PYTHON_PIP
	select BR2_PACKAGE_PYTHON_NUMPY
	select BR2_PACKAGE_PYTHON_FUTURE
	select BR2_PACKAGE_PYTHON_PARAMIKO
	select BR2_PACKAGE_PYTHON_PILLOW
	select BR2_PACKAGE_PYTHON_QRCODE
	select BR2_PACKAGE_PYTHON_REQUESTS
	select BR2_PACKAGE_PYTHON_SIX
	select BR2_PACKAGE_PYTHON_XMLTODICT
	select BR2_PACKAGE_PYTHON_ECDSA
	select BR2_PACKAGE_PYTHON_BITSTRING
	select BR2_PACKAGE_PYTHON_REEDSOLO
	select BR2_PACKAGE_PYTHON_GIT
	select BR2_PACKAGE_PYTHON_DNSPYTHON
	select BR2_PACKAGE_PYTHON_CRYPTOGRAPHY
	select BR2_PACKAGE_PYTHON_COLORAMA
	select BR2_PACKAGE_PYTHON_PYUSB
	select BR2_PACKAGE_PYTHON_WEBSOCKET_CLIENT

	# PyQt5
	select BR2_PACKAGE_PYTHON_PYQT5_SIP
	select BR2_PACKAGE_PYTHON_PYQT5

	# Qt5 core
	select BR2_PACKAGE_QT5
	select BR2_PACKAGE_QT5BASE
	select BR2_PACKAGE_QT5BASE_GUI
	select BR2_PACKAGE_QT5BASE_WIDGETS
	select BR2_PACKAGE_QT5BASE_OPENGL
	select BR2_PACKAGE_QT5BASE_OPENGL_ES2
	select BR2_PACKAGE_QT5BASE_LINUXFB
	select BR2_PACKAGE_QT5BASE_EGLFS

	# Wayland / Weston
	select BR2_PACKAGE_QT5WAYLAND
	select BR2_PACKAGE_QT5WAYLAND_COMPOSITOR
	select BR2_PACKAGE_WESTON_WAYLAND

	# System / tools
	select BR2_PACKAGE_FIO
	select BR2_PACKAGE_GREP
	select BR2_PACKAGE_UTIL_LINUX_BINARIES

	help
	  ProductionTool is a factory / production test application.
	  It is based on Python3, PyQt5, Qt5 and requires a full
	  graphical stack (Wayland/Weston) and multiple Python
	  runtime modules.
```

## package/rockchip/rockchip-ai/Config.in
```kconfig
config BR2_PACKAGE_ROCKCHIP_AI
    bool "rockchip ai"
    depends on BR2_GCC_ENABLE_OPENMP
    select BR2_PACKAGE_RKNPU2
    select BR2_PACKAGE_RKNN_LLM
```

## package/rockchip/rockit/Config.in
```kconfig
config BR2_PACKAGE_ROCKIT
	bool "rockit"
	select BR2_PACKAGE_ALSA_PLUGINS
	default n
	help
		rockit

choice
prompt "Platform type"
	default BR2_PACKAGE_ROCKIT_RV1126B
	help
	  Select a platform type.

config BR2_PACKAGE_ROCKIT_RV1126B
	bool "Compile for rv1126b rockit"
	select BR2_PACKAGE_IPC_DRV_KO
	depends on BR2_PACKAGE_ROCKIT

config BR2_PACKAGE_ROCKIT_RK3506
	bool "Compile for rk3506 rockit"
	depends on BR2_PACKAGE_ROCKIT

endchoice
```

## package/rockchip/wayland-cluster/Config.in
```kconfig
config BR2_PACKAGE_WAYLAND_CLUSTER
	bool "wayland-cluster"
	select BR2_PACKAGE_STB
	select BR2_PACKAGE_CAIRO
	select BR2_PACKAGE_FONTCONFIG
	depends on BR2_PACKAGE_HAS_LIBEGL
	depends on BR2_PACKAGE_WAYLAND
	select BR2_PACKAGE_WAYLAND_PROTOCOLS if BR2_PACKAGE_WAYLAND
	help
	  Cluster Demo application based on wayland
```
